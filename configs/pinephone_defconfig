## configs/pinephone_defconfig
```kconfig
CONFIG_ARM=y
CONFIG_ARCH_SUNXI=y
CONFIG_SPL=y
CONFIG_MACH_SUN50I=y
CONFIG_RESERVE_ALLWINNER_BOOT0_HEADER=y
CONFIG_SUNXI_DRAM_LPDDR3_STOCK=y
CONFIG_DRAM_CLK=552
CONFIG_DRAM_ZQ=3881949
CONFIG_MMC0_CD_PIN=""
CONFIG_MMC_SUNXI_SLOT_EXTRA=2
CONFIG_SPL_SPI_SUNXI=y
CONFIG_NR_DRAM_BANKS=1
CONFIG_DEFAULT_DEVICE_TREE="sun50i-a64-pinephone"

CONFIG_SYS_RELOC_GD_ENV_ADDR=y
CONFIG_CMD_FAT=y
CONFIG_CMD_FS_GENERIC=y
CONFIG_CMD_PART=y
CONFIG_HUSH_PARSER=y
CONFIG_ENV_IS_IN_FAT=y
CONFIG_SYS_CONSOLE_INFO_QUIET=y
CONFIG_BOOTDELAY=0
CONFIG_PINEPHONE_LEDS=y

#CONFIG_SPL_SERIAL_SUPPORT=n
CONFIG_DM_SPI_FLASH=n
CONFIG_SPI_FLASH=n
CONFIG_PHY=n
CONFIG_PHY_SUN4I_USB=n
CONFIG_SPI=n
CONFIG_DM_SPI=n
CONFIG_SPI_MEM=n
CONFIG_FAT_WRITE=n
CONFIG_SHA1=n
CONFIG_SHA256=n
CONFIG_MD5=n
CONFIG_LZMA=n
CONFIG_GZIP=n
CONFIG_ZLIB=n
CONFIG_CMD_LZMADEC=n
CONFIG_CMD_UNZIP=n
CONFIG_BOOTM_NETBSD=n
CONFIG_BOOTM_PLAN9=n
CONFIG_BOOTM_RTEMS=n
CONFIG_BOOTM_VXWORKS=n
CONFIG_FIT_ENABLE_SHA256_SUPPORT=n
CONFIG_CMD_BOOTM=y
CONFIG_LZ4=y
CONFIG_FIT=y
```
